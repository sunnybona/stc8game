#include <STC8G.H>

#include <stdio.h>

#include <math.h>
#include "ssd1306xled.h"

const uint8_t code  playerIdle1 []  =  { // inverted, bottom first
B00111100,
B11011011,
B11000010,
B11011011,
B00111100
};
const uint8_t code  playerIdle2 []  =  {
B00111011,
B11010111,
B11000101,
B11010111,
B00111011
};
const uint8_t code  playerRight1 []  =  {
B11110111,
B01111011,
B10011011,
B00000010,
B01101111
};
const uint8_t code  playerRight2 []  =  {
B00111111,
B11010011,
B11100010,
B00011011,
B11111111
};
const uint8_t code  playerLeft1 []  =  {
B01101111,
B00000010,
B10011011,
B01111011,
B11110111
};
const uint8_t code  playerLeft2 []  =  {
B11111111,
B00011011,
B11100010,
B11010011,
B00111111
};
const uint8_t code  bomb1 []  =  {
B11111111,
B10001111,
B01111111,
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B10000001,
B11000111
};

const uint8_t code  bottle1 []  =  {
B11111111,
B11101111,
B00001011,
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B00011000,
B10000001
};

const uint8_t code  splash  []  =  {
0x00, 0x00, 0x00, 0x00, 0x00, 0x00, 0x00, 0x00, 0x00, 0x00, 0x00, 0x00, 0x00, 0x00, 0x00, 0x06,
0x3E, 0xFE, 0xE2, 0xC2, 0xFE, 0x80, 0x00, 0x00, 0x00, 0xC0, 0x80, 0x00, 0x00, 0xC0, 0xC0, 0x80,
0x00, 0x20, 0x70, 0xC0, 0xE0, 0x30, 0x70, 0xE0, 0x80, 0x00, 0x00, 0x00, 0x00, 0x00, 0x00, 0x00,
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0x7F, 0xFF, 0xFF, 0xFF, 0xFF, 0xFF, 0xF7, 0xF7, 0xE7, 0xE3, 0xFF, 0xFF, 0xFF, 0xFD, 0xFC, 0x6C
};

unsigned long activeMillis = 0;
byte bombX[16] = {0,0,0,0,0,0,0,0,0,0,0,0,0,0,0,0};
byte bombY[16] = {0,0,0,0,0,0,0,0,0,0,0,0,0,0,0,0};
byte bombStatus[16] = {0,0,0,0,0,0,0,0,0,0,0,0,0,0,0,0};
byte totalBombs = 1;
byte maxBombs = 16;
byte playerOffset = 62;
byte playerStatus = 0; // 0 idle, 1 right, 2 left
byte quadFrameCount = 0;
boolean btn1 = 0;
boolean btn2 = 0;
unsigned int score = 0;
unsigned long lastFrame = 0;
unsigned long lastBomb = 0;
int bombDelay = 1500;
int frameDelay = 40;
byte playerStep = 2;
boolean stopAnimate = 0;



void resetGame(){
	byte i;
	
	ssd1306_fillscreen(0x00);
	ssd1306_char_f6x8(22, 2, "Run Dude Run");
	  
	ssd1306_char_f6x8(26, 7, "Stc8 Arcade");  
	waitStart();
	delay(1000);
	
	ssd1306_draw_bmp(0,0,128,8,splash);
	delay(2000);
     

	ssd1306_fillscreen(B00000000);

	stopAnimate=0;
	for (i = 0; i<16; i++){
		bombX[i] = 0;
		bombY[i] = 0;
		bombStatus[i] = 0;
	}
	totalBombs = 1;
	bombDelay = 1500;
	frameDelay = 40;
	score = 0;
	
}

void drawBombs(){
	byte bi,tb;
  if (lastBomb+bombDelay<millis()){
    lastBomb = millis();
     
    if (score < 10 && score > 0){
       totalBombs++; 
    }else if (score>100&&score<1000){
      bombDelay = 3000;
      if (frameDelay>0){frameDelay--;}
    }else if (score > 1000){
      if (totalBombs<maxBombs){
       totalBombs++;
      } 
    }
  }
  for (bi = 0; bi<totalBombs; bi++){
    if (bombStatus[bi] != 1){
      bombStatus[bi] = 1;
      bombX[bi]=random(0,120);
      bombY[bi]=0;
    }
  }
    
  for (tb = 0; tb < totalBombs; tb++){
    if (bombStatus[tb]==1){
			byte offset,offset2;
       bombY[tb] ++;      if (bombY[tb]>=63){bombY[tb]=0;}  // remove later
       offset = 8- bombY[tb]%8;
       offset2 =  bombY[tb]%8;
       
      
       if (bombY[tb]>0){
              ssd1306_setpos(bombX[tb],bombY[tb]/8);
              ssd1306_send_data_start();
              ssd1306_send_byte((~bomb1[7])>>offset^B11111111<<offset2);
              ssd1306_send_byte((~bomb1[8])>>offset^B11111111<<offset2);
              ssd1306_send_byte((~bomb1[9])>>offset^B11111111<<offset2);
              ssd1306_send_byte((~bomb1[10])>>offset^B11111111<<offset2);
              ssd1306_send_byte((~bomb1[11])>>offset^B11111111<<offset2);
              ssd1306_send_byte((~bomb1[12])>>offset^B11111111<<offset2);
              ssd1306_send_byte((~bomb1[13])>>offset^B11111111<<offset2);
              ssd1306_send_data_stop();
              
       }
       
       if (bombY[tb]>=8){
              ssd1306_setpos(bombX[tb],bombY[tb]/8-1);
              ssd1306_send_data_start();
              ssd1306_send_byte((((~bomb1[0])>>offset)^B11111111<<offset2)|(~bomb1[7])<<offset2);
              ssd1306_send_byte((((~bomb1[1])>>offset)^B11111111<<offset2)|(~bomb1[8])<<offset2);
              ssd1306_send_byte((((~bomb1[2])>>offset)^B11111111<<offset2)|(~bomb1[9])<<offset2);
              ssd1306_send_byte((((~bomb1[3])>>offset)^B11111111<<offset2)|(~bomb1[10])<<offset2);
              ssd1306_send_byte((((~bomb1[4])>>offset)^B11111111<<offset2)|(~bomb1[11])<<offset2);
              ssd1306_send_byte((((~bomb1[5])>>offset)^B11111111<<offset2)|(~bomb1[12])<<offset2);
              ssd1306_send_byte((((~bomb1[6])>>offset)^B11111111<<offset2)|(~bomb1[13])<<offset2);
              ssd1306_send_data_stop();      
       }
       if (bombY[tb]>=16){
              ssd1306_setpos(bombX[tb],bombY[tb]/8-2);
              ssd1306_send_data_start();
              ssd1306_send_byte((~bomb1[0])<<offset2);
              ssd1306_send_byte((~bomb1[1])<<offset2);
              ssd1306_send_byte((~bomb1[2])<<offset2);
              ssd1306_send_byte((~bomb1[3])<<offset2);
              ssd1306_send_byte((~bomb1[4])<<offset2);
              ssd1306_send_byte((~bomb1[5])<<offset2);
              ssd1306_send_byte((~bomb1[6])<<offset2);
              ssd1306_send_data_stop();
       }
       if (bombY[tb]>56 && (playerOffset<bombX[tb]+7&&playerOffset+5>bombX[tb])){
         
         stopAnimate=1;
         
       }
       
       if (bombY[tb]>59){
//              analogWrite(1,127);
              ssd1306_setpos(bombX[tb],bombY[tb]/8-1);
              ssd1306_send_data_start();
              ssd1306_send_byte(B00000000);
              ssd1306_send_byte(B00000000);
              ssd1306_send_byte(B00000000);
              ssd1306_send_byte(B00000000);
              ssd1306_send_byte(B00000000);
              ssd1306_send_byte(B00000000);
              ssd1306_send_byte(B00000000);
              ssd1306_send_data_stop();
         
              ssd1306_setpos(bombX[tb],7);
              ssd1306_send_data_start();
              ssd1306_send_byte(B00111100);
              ssd1306_send_byte(B01011010);
              ssd1306_send_byte(B10100101);
              ssd1306_send_byte(B01010101);
              ssd1306_send_byte(B10101010);
              ssd1306_send_byte(B01011010);
              ssd1306_send_byte(B00111100);
              ssd1306_send_data_stop();
       }
       if (bombY[tb]==62){
              ssd1306_setpos(bombX[tb],bombY[tb]/8);
              ssd1306_send_data_start();
              ssd1306_send_byte(B00000000);
              ssd1306_send_byte(B00000000);
              ssd1306_send_byte(B00000000);
              ssd1306_send_byte(B00000000);
              ssd1306_send_byte(B00000000);
              ssd1306_send_byte(B00000000);
              ssd1306_send_byte(B00000000);
              ssd1306_send_data_stop();
              
              bombStatus[tb] = 0;
              score++;
//              digitalWrite(1,0);
       }
       
    }else {
      
    }
  }
  //delay(1000);
}
void drawPlayer(){
  ssd1306_setpos(playerOffset-5,7);
  ssd1306_send_data_start();
  ssd1306_send_byte(B00000000); // erase player's previous position
  ssd1306_send_byte(B00000000);
  ssd1306_send_byte(B00000000);
  ssd1306_send_byte(B00000000);
  ssd1306_send_byte(B00000000);
  ssd1306_send_byte(B00000000);
  ssd1306_send_byte(B00000000);
  ssd1306_send_byte(B00000000);
  ssd1306_send_byte(B00000000);
  ssd1306_send_byte(B00000000);
  ssd1306_send_byte(B00000000);
  ssd1306_send_byte(B00000000);
  ssd1306_send_byte(B00000000);
  ssd1306_send_byte(B00000000);
  ssd1306_send_byte(B00000000);
  ssd1306_send_data_stop();
  if (playerStatus==1&&quadFrameCount<2){
    ssd1306_draw_bmp(playerOffset,7,playerOffset+5,8,playerRight1);
  }else if (playerStatus==1){
    ssd1306_draw_bmp(playerOffset,7,playerOffset+5,8,playerRight2);
  }else if (playerStatus==2&&quadFrameCount<2){
    ssd1306_draw_bmp(playerOffset,7,playerOffset+5,8,playerLeft1);
  }else if (playerStatus==2){
    ssd1306_draw_bmp(playerOffset,7,playerOffset+5,8,playerLeft2);
  }else if (quadFrameCount<2){
    ssd1306_draw_bmp(playerOffset,7,playerOffset+5,8,playerIdle1);
  }else {
    ssd1306_draw_bmp(playerOffset,7,playerOffset+5,8,playerIdle2); 
  }
}





void setup() {
	byte tb;
	ssd1306_init();
	activeMillis = millis();
  
  resetGame();
  
  for (tb = 1; tb <= totalBombs; tb++){
   bombY[tb]=random(0,64); 
  }
	
  
}


void loop() { 
#if 1
  
    char charBuf[4];  
	
//	ssd1306_fillscreen(0x00);
//	ssd1306_char_f6x8(16, 2, "B R E A K O U T");
//	ssd1306_char_f6x8(20, 4, "press A to play");
//	delay(200); 
//	ssd1306_char_f6x8(22, 7, "Tiny Stc8g"); 
//	beep(200,600);          beep(300,200);          beep(400,300);
//	delay(2000);
	
 

		

	
		
//		lastFrame=millis();
//    ssd1306_draw_bmp(playerOffset,7,playerOffset+5,8,playerRight1);
     if (frameDelay+lastFrame < millis()){
              lastFrame = millis();
              playerStatus = 0;
              if (RIGHT==1||btn1==1){
                playerStatus = 2;
                if (playerOffset >0){
                   playerOffset -=playerStep;
                }
                btn1 = 0;
              }
              if (LEFT==1||btn2==1){
                playerStatus = 1;
                if (playerOffset < 121){
                  playerOffset +=playerStep;
                }
                btn2 = 0;
              }
              
              
              drawPlayer();
              drawBombs();
              quadFrameCount++;
              if (quadFrameCount>=3){quadFrameCount = 0;}   
                  
                  
                  
                  //ssd1306_draw_bmp(14,0,21,2,bomb1);
                 // delay(150);
                  
                 //ssd1306_draw_bmp(22,2,28,4,bottle1);
                  //delay(150);
             //     
             
             // display score
                if (stopAnimate==1){
									int i;
                 int topScore = 0;
                    topScore = topScore << 8;
                    topScore = 0;
                    
                    if (score>topScore){topScore = score; }

                    ssd1306_char_f6x8(32, 3, "Game Over");
                    ssd1306_char_f6x8(32, 5, "score:");
                    sprintf(charBuf,"%d",score);
                    ssd1306_char_f6x8(70, 5, charBuf);
                    ssd1306_char_f6x8(32, 6, "top score:");
                    sprintf(charBuf,"%d",score);
                    ssd1306_char_f6x8(90, 6, charBuf);
                    for (i = 0; i<1000; i++){
                      beep(1,random(0,i*2));
                    }
                    delay(2000);
                   
                    ssd1306_fillscreen(B00000000);
                    resetGame();
                     
                }
                
								sprintf(charBuf,"%d",score);
                
                ssd1306_char_f6x8(92, 0, charBuf);
                
               if (activeMillis+30000<millis()||stopAnimate==1){

               }
               
        
     }	
//          	 while((millis()-lastFrame)<30);
             //     
               
	
#endif
}


void main() { 

      
	setup();
	
	


	while (1) {
		
		loop();
		
	}
		
}
             